## u-boot-2018.09/board/freescale/ls1046ardb_t80/Kconfig
```kconfig
if TARGET_LS1046ARDB_WG_T80

config WG1008_VM1P
    default 1

config SYS_BOARD
	default "ls1046ardb_t80"

config SYS_VENDOR
	default "freescale"

config SYS_SOC
	default "fsl-layerscape"

config SYS_CONFIG_NAME
	default "ls1046ardb_t80"

if FSL_LS_PPA
#Albert.Ke.B
#config SYS_LS_PPA_FW_ADDR
#	hex "PPA Firmware Addr"
#	default 0x40400000 if SYS_LS_PPA_FW_IN_XIP && QSPI_BOOT
#	default 0x400000 if SYS_LS_PPA_FW_IN_MMC || SYS_LS_PPA_FW_IN_NAND
config SYS_LS_PPA_FW_ADDR
	hex "PPA Firmware Addr"
	default 0x40240000 if SYS_LS_PPA_FW_IN_XIP && QSPI_BOOT
	default 0x240000 if SYS_LS_PPA_FW_IN_MMC || SYS_LS_PPA_FW_IN_NAND
#Albert.Ke.E

if CHAIN_OF_TRUST
config SYS_LS_PPA_ESBC_ADDR
	hex "PPA Firmware HDR Addr"
	default 0x40680000 if SYS_LS_PPA_FW_IN_XIP && QSPI_BOOT
	default 0x680000 if SYS_LS_PPA_FW_IN_MMC || SYS_LS_PPA_FW_IN_NAND
endif
endif

source "board/freescale/common/Kconfig"
endif
```

## u-boot-2018.09/configs/ls1012afrwy_wg_nv5_qspi_defconfig
```kconfig
CONFIG_ARM=y
CONFIG_TARGET_LS1012AFRWY_WG_NV5=y
CONFIG_SYS_TEXT_BASE=0x40100000
CONFIG_FSL_LS_PPA=y
CONFIG_DISTRO_DEFAULTS=y
CONFIG_NR_DRAM_BANKS=2
# CONFIG_SYS_MALLOC_F is not set
CONFIG_FIT_VERBOSE=y
CONFIG_OF_BOARD_SETUP=y
CONFIG_OF_STDOUT_VIA_ALIAS=y
CONFIG_SYS_EXTRA_OPTIONS="QSPI_BOOT"
CONFIG_QSPI_BOOT=y
CONFIG_CONS_INDEX=2
CONFIG_BOOTDELAY=3
CONFIG_USE_BOOTARGS=y
CONFIG_BOOTARGS="console=ttyS1,115200 root=/dev/ram0 earlycon=uart8250,mmio,0x21c0500 quiet lpj=250000"
# CONFIG_DISPLAY_BOARDINFO is not set
CONFIG_DISPLAY_BOARDINFO_LATE=y
CONFIG_CMD_GREPENV=y
CONFIG_CMD_GPT=y
CONFIG_CMD_I2C=y
CONFIG_CMD_MMC=y
CONFIG_CMD_PCI=y
CONFIG_CMD_SF=y
CONFIG_CMD_USB=y
CONFIG_CMD_MII=y
# CONFIG_CMD_SETEXPR is not set
CONFIG_CMD_CACHE=y
CONFIG_OF_CONTROL=y
CONFIG_DEFAULT_DEVICE_TREE="fsl-ls1012a-frwy"
CONFIG_ENV_IS_IN_SPI_FLASH=y
# CONFIG_NET_RANDOM_ETHADDR is not set
CONFIG_DM=y
CONFIG_DM_MMC=y
CONFIG_SPI_FLASH=y
CONFIG_SPI_FLASH_MACRONIX=y
CONFIG_FSL_PFE=y
CONFIG_MV88E6XXX_SWITCH=y
CONFIG_DM_ETH=y
CONFIG_E1000=y
CONFIG_PCI=y
CONFIG_DM_PCI=y
CONFIG_DM_PCI_COMPAT=y
CONFIG_PCIE_LAYERSCAPE=y
CONFIG_SYS_NS16550=y
CONFIG_USB=y
CONFIG_DM_USB=y
CONFIG_USB_XHCI_HCD=y
CONFIG_USB_XHCI_DWC3=y
CONFIG_USB_STORAGE=y
CONFIG_DM_SCSI=y
CONFIG_SATA_CEVA=y
CONFIG_SCSI_AHCI=y
CONFIG_SCSI=y
CONFIG_AHCI=y
CONFIG_CMD_DATE=y
CONFIG_RTC_S35392A=y
CONFIG_CMD_GPIO=y
CONFIG_PHY_FIXED=y
CONFIG_PHYLIB=y
CONFIG_NET=y
```

## u-boot-2018.09/net/Kconfig
```kconfig
#
# Network configuration
#

menuconfig NET
	bool "Networking support"
	default y

if NET

config NET_RANDOM_ETHADDR
	bool "Random ethaddr if unset"
	help
	  Selecting this will allow the Ethernet interface to function
	  even when the ethaddr variable for that interface is unset.
	  A new MAC address will be generated on every boot and it will
	  not be added to the environment.

config NETCONSOLE
	bool "NetConsole support"
	help
	  Support the 'nc' input/output device for networked console.
	  See README.NetConsole for details.

# Forest Tsao B
config MV88E6190_SWITCH
    default 0
config MV88E6190_SWITCH_CPU_ATTACHED
	depends on MV88E6190_SWITCH
    default 1
# Forest Tsao E

endif   # if NET
```
